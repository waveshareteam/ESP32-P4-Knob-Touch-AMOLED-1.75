## examples/esp-idf/01_system_info/sdkconfig.defaults
```kconfig
CONFIG_LOG_DEFAULT_LEVEL_INFO=y
CONFIG_COMPILER_OPTIMIZATION_SIZE=y
CONFIG_ESP_MAIN_TASK_STACK_SIZE=8192
CONFIG_PARTITION_TABLE_SINGLE_APP=y
CONFIG_ESPTOOLPY_FLASHMODE_QIO=y

CONFIG_SPIRAM=y
CONFIG_SPIRAM_MODE_HEX=y
CONFIG_SPIRAM_SPEED_200M=y
CONFIG_SPIRAM_FETCH_INSTRUCTIONS=y
CONFIG_SPIRAM_RODATA=y
CONFIG_SPIRAM_XIP_FROM_PSRAM=y
CONFIG_SPIRAM_FLASH_LOAD_TO_PSRAM=y
CONFIG_SPIRAM_USE_MALLOC=y
CONFIG_SPIRAM_MEMTEST=y
CONFIG_SPIRAM_MALLOC_ALWAYSINTERNAL=16384
CONFIG_SPIRAM_MALLOC_RESERVE_INTERNAL=32768
CONFIG_FREERTOS_TASK_CREATE_ALLOW_EXT_MEM=y
```

## examples/esp-idf/03_wifi/sdkconfig.defaults
```kconfig
CONFIG_LOG_DEFAULT_LEVEL_INFO=y
CONFIG_COMPILER_OPTIMIZATION_SIZE=y
CONFIG_ESP_MAIN_TASK_STACK_SIZE=8192
CONFIG_PARTITION_TABLE_SINGLE_APP_LARGE=y
CONFIG_PARTITION_TABLE_OFFSET=0x10000

CONFIG_ESP_WIFI_STATIC_RX_BUFFER_NUM=8
CONFIG_ESP_WIFI_DYNAMIC_RX_BUFFER_NUM=16

CONFIG_BT_ENABLED=y
CONFIG_BT_BLUEDROID_ENABLED=y
CONFIG_BT_CLASSIC_ENABLED=n
CONFIG_BT_BLE_ENABLED=y
CONFIG_BT_GATTS_ENABLE=n
CONFIG_BT_GATTC_ENABLE=n
CONFIG_BT_BLE_SMP_ENABLE=n
CONFIG_BT_BLE_42_FEATURES_SUPPORTED=y
CONFIG_BT_CONTROLLER_DISABLED=y
```

## examples/esp-idf/06_sd_card/main/Kconfig.projbuild
```kconfig
menu "06 SD card test"
    config SD06_PRIMARY_BUS_WIDTH
        int "Primary SDMMC bus width"
        range 1 4
        default 4

    config SD06_PRIMARY_FREQ_KHZ
        int "Primary SDMMC maximum frequency in kHz"
        range 400 40000
        default 40000

    config SD06_FALLBACK_FREQ_KHZ
        int "Fallback SDMMC maximum frequency in kHz"
        range 400 20000
        default 20000
endmenu
```

## examples/esp-idf/07_limit_switches/main/Kconfig.projbuild
```kconfig
menu "Limit switch test"

    choice LIMIT_SWITCHES_TEST_MODE
        prompt "Diagnostic mode"
        default LIMIT_SWITCHES_MODE_GPIO_IRQ
        help
            The default mode confirms both GPIO inputs after their levels hold
            for the configured debounce interval. Polling and PCNT modes are
            retained for diagnosis.

        config LIMIT_SWITCHES_MODE_INPUT_ONLY
            bool "Input-only: configure pins without reading them"

        config LIMIT_SWITCHES_MODE_POLLING
            bool "Polling: read both pins every 10 ms"

        config LIMIT_SWITCHES_MODE_GPIO_IRQ
            bool "GPIO interrupt: confirm both pin levels after each edge"

        config LIMIT_SWITCHES_MODE_PCNT
            bool "PCNT: hardware falling-edge counting"
    endchoice

    choice LIMIT_SWITCHES_BIAS_MODE
        prompt "GPIO20/GPIO21 internal bias"
        default LIMIT_SWITCHES_BIAS_PULLUP
        help
            Select only when hardware inspection requires an internal pull resistor.

        config LIMIT_SWITCHES_BIAS_NONE
            bool "No internal pull-up or pull-down"

        config LIMIT_SWITCHES_BIAS_PULLUP
            bool "Enable internal pull-up"

        config LIMIT_SWITCHES_BIAS_PULLDOWN
            bool "Enable internal pull-down"
    endchoice

    config LIMIT_SWITCHES_DEBOUNCE_MS
        int "GPIO level settle time in ms"
        range 1 500
        default 2
        help
            An edge only restarts this timer. The GPIO level is counted when
            it has held for the full interval.
endmenu
```

## examples/esp-idf/07_limit_switches/sdkconfig.defaults
```kconfig
CONFIG_LOG_DEFAULT_LEVEL_INFO=y
CONFIG_COMPILER_OPTIMIZATION_SIZE=y
CONFIG_ESP_MAIN_TASK_STACK_SIZE=12288
CONFIG_PARTITION_TABLE_SINGLE_APP=y
CONFIG_PARTITION_TABLE_OFFSET=0x10000
CONFIG_ESPTOOLPY_FLASHMODE_QIO=y
CONFIG_LV_CONF_SKIP=y
CONFIG_LIMIT_SWITCHES_MODE_POLLING=y
CONFIG_LIMIT_SWITCHES_BIAS_PULLUP=y
CONFIG_LIMIT_SWITCHES_DEBOUNCE_MS=30
CONFIG_LV_FONT_MONTSERRAT_24=y
CONFIG_LV_FONT_MONTSERRAT_32=y

CONFIG_SPIRAM=y
CONFIG_SPIRAM_MODE_HEX=y
CONFIG_SPIRAM_SPEED_200M=y
# CONFIG_SPIRAM_FETCH_INSTRUCTIONS is not set
# CONFIG_SPIRAM_RODATA is not set
# CONFIG_SPIRAM_XIP_FROM_PSRAM is not set
# CONFIG_SPIRAM_FLASH_LOAD_TO_PSRAM is not set
CONFIG_SPIRAM_USE_MALLOC=y
CONFIG_SPIRAM_MEMTEST=y
CONFIG_SPIRAM_MALLOC_ALWAYSINTERNAL=16384
CONFIG_SPIRAM_MALLOC_RESERVE_INTERNAL=32768
CONFIG_FREERTOS_TASK_CREATE_ALLOW_EXT_MEM=y
CONFIG_FREERTOS_HZ=100
# CONFIG_FREERTOS_CORETIMER_SYSTIMER_LVL1 is not set
CONFIG_FREERTOS_CORETIMER_SYSTIMER_LVL3=y
CONFIG_GPIO_CTRL_FUNC_IN_IRAM=y
CONFIG_LV_DEF_REFR_PERIOD=10
# CONFIG_LV_BUILD_EXAMPLES is not set
# CONFIG_LV_BUILD_DEMOS is not set

CONFIG_ESP_SYSTEM_USE_FRAME_POINTER=y
CONFIG_ESP_SYSTEM_PANIC_REBOOT_DELAY_SECONDS=3
CONFIG_ESP_COREDUMP_ENABLE_TO_UART=y
CONFIG_ESP_COREDUMP_DATA_FORMAT_ELF=y
CONFIG_ESP_COREDUMP_CHECKSUM_CRC32=y
CONFIG_ESP_COREDUMP_DECODE_INFO=y
```

## examples/esp-idf/08_motor_drive/main/Kconfig.projbuild
```kconfig
menu "08 motor drive"
    config MOTOR08_MAX_ON_MS
        int "Maximum single vibration time in ms"
        range 300 500
        default 400
endmenu
```

## examples/esp-idf/11_display_touch/main/Kconfig.projbuild
```kconfig
menu "11 display touch"
    config DISPLAY11_COLOR_STAGE_MS
        int "Each LVGL color stage duration in ms"
        range 1500 2000
        default 1800

    config DISPLAY11_DOT_MAX
        int "Maximum retained touch dots"
        range 16 256
        default 128
endmenu
```

## examples/esp-idf/12_mic_spectrum/sdkconfig.defaults
```kconfig
CONFIG_LOG_DEFAULT_LEVEL_INFO=y
CONFIG_COMPILER_OPTIMIZATION_SIZE=y
CONFIG_ESP_MAIN_TASK_STACK_SIZE=12288
CONFIG_FREERTOS_HZ=1000
CONFIG_PARTITION_TABLE_SINGLE_APP=y
CONFIG_ESPTOOLPY_FLASHMODE_QIO=y

CONFIG_LV_CONF_SKIP=y

CONFIG_SPIRAM=y
CONFIG_SPIRAM_MODE_HEX=y
CONFIG_SPIRAM_SPEED_200M=y
CONFIG_SPIRAM_FETCH_INSTRUCTIONS=y
CONFIG_SPIRAM_RODATA=y
CONFIG_SPIRAM_XIP_FROM_PSRAM=y
CONFIG_SPIRAM_FLASH_LOAD_TO_PSRAM=y
CONFIG_SPIRAM_USE_MALLOC=y
CONFIG_SPIRAM_MEMTEST=y
CONFIG_SPIRAM_MALLOC_ALWAYSINTERNAL=16384
CONFIG_SPIRAM_MALLOC_RESERVE_INTERNAL=32768
CONFIG_FREERTOS_TASK_CREATE_ALLOW_EXT_MEM=y
CONFIG_DSP_MAX_FFT_SIZE=512
# CONFIG_LV_BUILD_EXAMPLES is not set
# CONFIG_LV_BUILD_DEMOS is not set
CONFIG_BOOTLOADER_LOG_LEVEL_WARN=y
```

## examples/esp-idf/13_speaker_output/sdkconfig.defaults
```kconfig
CONFIG_LOG_DEFAULT_LEVEL_INFO=y
CONFIG_COMPILER_OPTIMIZATION_SIZE=y
CONFIG_ESP_MAIN_TASK_STACK_SIZE=4096
CONFIG_PARTITION_TABLE_SINGLE_APP=y
```

## examples/esp-idf/14_usb_display/sdkconfig.defaults
```kconfig
CONFIG_LOG_DEFAULT_LEVEL_INFO=y
CONFIG_COMPILER_OPTIMIZATION_SIZE=y
CONFIG_ESP_MAIN_TASK_STACK_SIZE=8192
CONFIG_PARTITION_TABLE_SINGLE_APP=y
CONFIG_ESPTOOLPY_FLASHMODE_QIO=y
```

## examples/esp-idf/16_a2dp_sink/sdkconfig.defaults
```kconfig
# Override some defaults so BT stack is enabled and
# Classic BT is enabled and BT_DRAM_RELEASE is disabled
CONFIG_IDF_TARGET="esp32p4"
CONFIG_ESPTOOLPY_FLASHMODE_QIO=y
CONFIG_PARTITION_TABLE_CUSTOM=y
CONFIG_COMPILER_OPTIMIZATION_PERF=y
CONFIG_SPIRAM=y
CONFIG_SPIRAM_SPEED_200M=y
CONFIG_SPIRAM_XIP_FROM_PSRAM=y
CONFIG_SPIRAM_MALLOC_ALWAYSINTERNAL=4096
CONFIG_SPIRAM_MALLOC_RESERVE_INTERNAL=131072

CONFIG_CACHE_L2_CACHE_256KB=y
CONFIG_CACHE_L2_CACHE_LINE_128B=y
CONFIG_ESP_MAIN_TASK_STACK_SIZE=10240
CONFIG_FREERTOS_HZ=1000
# CONFIG_FREERTOS_CORETIMER_SYSTIMER_LVL1 is not set
CONFIG_FREERTOS_CORETIMER_SYSTIMER_LVL3=y
CONFIG_FREERTOS_VTASKLIST_INCLUDE_COREID=y
CONFIG_FREERTOS_GENERATE_RUN_TIME_STATS=y

CONFIG_BT_ENABLED=y
CONFIG_BT_BLUEDROID_ENABLED=y
CONFIG_BT_CLASSIC_ENABLED=y
CONFIG_BT_A2DP_ENABLE=y
CONFIG_BT_AVRCP_CT_COVER_ART_ENABLED=y
CONFIG_DAC_DMA_AUTO_16BIT_ALIGN=n
CONFIG_ESPTOOLPY_FLASHSIZE_32MB=y
CONFIG_ESP_EXT_CONN_SLAVE_ENABLE_PIN=54
CONFIG_ESP_EXT_CONN_SLAVE_ENABLE_LVL=1
CONFIG_ESP_EXT_CONN_SLAVE_BOOT_PIN=6
CONFIG_ESP_EXT_CONN_SDIO_SLOT=1
CONFIG_ESP_EXT_CONN_SDIO_CLK_PIN=18
CONFIG_ESP_EXT_CONN_SDIO_CMD_PIN=19
CONFIG_ESP_EXT_CONN_SDIO_D0_PIN=14
CONFIG_ESP_EXT_CONN_SDIO_D1_PIN=15
CONFIG_ESP_EXT_CONN_SDIO_D2_PIN=16
CONFIG_ESP_EXT_CONN_SDIO_D3_PIN=17
CONFIG_BT_BLE_50_FEATURES_SUPPORTED=n
CONFIG_BT_BLE_42_FEATURES_SUPPORTED=y

CONFIG_LV_USE_CLIB_MALLOC=y
CONFIG_LV_USE_CLIB_STRING=y
CONFIG_LV_USE_CLIB_SPRINTF=y
CONFIG_LV_DEF_REFR_PERIOD=10
CONFIG_LV_OS_FREERTOS=y
CONFIG_LV_DRAW_SW_DRAW_UNIT_CNT=2
# Avoid conflicting LVGL IRAM attributes with the ESP-IDF 6 toolchain.
CONFIG_LV_ATTRIBUTE_FAST_MEM_USE_IRAM=n
CONFIG_LV_FONT_MONTSERRAT_12=y
CONFIG_LV_FONT_MONTSERRAT_16=y
CONFIG_LV_FONT_MONTSERRAT_18=y
CONFIG_LV_FONT_MONTSERRAT_20=y
CONFIG_LV_FONT_MONTSERRAT_22=y
CONFIG_LV_FONT_MONTSERRAT_24=y
CONFIG_LV_FONT_MONTSERRAT_26=y
CONFIG_LV_USE_FONT_COMPRESSED=y
CONFIG_LV_FONT_FMT_TXT_LARGE=y
CONFIG_LV_TXT_BREAK_CHARS=" ,.;:-_"
CONFIG_LV_USE_SYSMON=y
CONFIG_LV_USE_PERF_MONITOR=y
CONFIG_LV_USE_IMGFONT=y
CONFIG_LV_USE_DEMO_WIDGETS=y
CONFIG_LV_USE_DEMO_BENCHMARK=y
CONFIG_LV_USE_DEMO_RENDER=y
CONFIG_LV_USE_DEMO_STRESS=y
CONFIG_LV_USE_DEMO_MUSIC=y
CONFIG_LV_DEMO_MUSIC_AUTO_PLAY=y
CONFIG_LV_USE_DEMO_FLEX_LAYOUT=y
CONFIG_LV_USE_DEMO_MULTILANG=y
CONFIG_IDF_EXPERIMENTAL_FEATURES=y
CONFIG_BOOTLOADER_LOG_LEVEL_WARN=y
```

## examples/esp-idf/common/knob_wireless/sdkconfig.defaults.wireless
```kconfig
CONFIG_ESP_EXT_CONN_ENABLE=y
CONFIG_ESP_EXT_CONN_WIFI_ENABLE=y
CONFIG_ESP_EXT_CONN_BT_ENABLE=y
CONFIG_ESP_EXT_CONN_VIA_SDIO=y
CONFIG_ESP_EXT_CONN_SLAVE_ENABLE_PIN=54
CONFIG_ESP_EXT_CONN_SLAVE_BOOT_PIN=6
CONFIG_ESP_EXT_CONN_SLAVE_ENABLE_LVL=1
CONFIG_ESP_EXT_CONN_SDIO_SLOT=1
CONFIG_ESP_EXT_CONN_SDIO_CLK_PIN=18
CONFIG_ESP_EXT_CONN_SDIO_CMD_PIN=19
CONFIG_ESP_EXT_CONN_SDIO_D0_PIN=14
CONFIG_ESP_EXT_CONN_SDIO_D1_PIN=15
CONFIG_ESP_EXT_CONN_SDIO_D2_PIN=16
CONFIG_ESP_EXT_CONN_SDIO_D3_PIN=17
CONFIG_ESP_EXT_CONN_RECV_TASK_STACK=4096
CONFIG_ESP_HOST_WIFI_ENABLED=y
CONFIG_ESP_WIFI_CONTROLLER_TARGET="esp32"
```

## examples/esp-idf/peripheral_tests/03_wifi/sdkconfig.defaults
```kconfig
CONFIG_LOG_DEFAULT_LEVEL_INFO=y
CONFIG_COMPILER_OPTIMIZATION_SIZE=y
CONFIG_ESP_MAIN_TASK_STACK_SIZE=8192
CONFIG_PARTITION_TABLE_SINGLE_APP=y

CONFIG_ESP_EXT_CONN_ENABLE=y
CONFIG_ESP_EXT_CONN_WIFI_ENABLE=y
CONFIG_ESP_EXT_CONN_BT_ENABLE=y
CONFIG_ESP_EXT_CONN_VIA_SDIO=y
CONFIG_ESP_EXT_CONN_SLAVE_ENABLE_PIN=54
CONFIG_ESP_EXT_CONN_SLAVE_BOOT_PIN=6
CONFIG_ESP_EXT_CONN_SLAVE_ENABLE_LVL=1
CONFIG_ESP_EXT_CONN_SDIO_SLOT=1
CONFIG_ESP_EXT_CONN_SDIO_CLK_PIN=18
CONFIG_ESP_EXT_CONN_SDIO_CMD_PIN=19
CONFIG_ESP_EXT_CONN_SDIO_D0_PIN=14
CONFIG_ESP_EXT_CONN_SDIO_D1_PIN=15
CONFIG_ESP_EXT_CONN_SDIO_D2_PIN=16
CONFIG_ESP_EXT_CONN_SDIO_D3_PIN=17
CONFIG_ESP_EXT_CONN_RECV_TASK_STACK=4096

CONFIG_ESP_HOST_WIFI_ENABLED=y
CONFIG_ESP_WIFI_CONTROLLER_TARGET="esp32"
CONFIG_ESP_WIFI_STATIC_RX_BUFFER_NUM=8
CONFIG_ESP_WIFI_DYNAMIC_RX_BUFFER_NUM=16

CONFIG_BT_ENABLED=y
CONFIG_BT_BLUEDROID_ENABLED=y
CONFIG_BT_CLASSIC_ENABLED=n
CONFIG_BT_BLE_ENABLED=y
CONFIG_BT_GATTS_ENABLE=n
CONFIG_BT_GATTC_ENABLE=n
CONFIG_BT_BLE_SMP_ENABLE=n
CONFIG_BT_BLE_42_FEATURES_SUPPORTED=y
CONFIG_BT_CONTROLLER_DISABLED=y
```
